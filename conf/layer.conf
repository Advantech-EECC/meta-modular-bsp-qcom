## conf/layer.conf
```bitbake
BBPATH .= ":${LAYERDIR}"

BBFILES += "${LAYERDIR}/recipes-*/*/*.bb \
            ${LAYERDIR}/recipes-*/*/*.bbappend"

BBFILE_COLLECTIONS += "eecc-qualcomm"
BBFILE_PATTERN_eecc-qualcomm = "^${LAYERDIR}/"
BBFILE_PRIORITY_eecc-qualcomm = "9"
LAYERVERSION_eecc-qualcomm = "4"
LAYERSERIES_COMPAT_eecc-qualcomm = "wrynose"
```

## conf/machine/aom5721-qcs6490-db6700.conf
```bitbake
MACHINEOVERRIDES =. "aom5721:"

require conf/machine/rb3gen2-core-kit.conf

KERNEL_DEVICETREE_BASENAME = "${MACHINE}"

DTBOS_EXTRA = " \
    eeprom \
    ethernet \
    gpio-expander \
    i2c9 \
    pmic \
    rtc \
    spi7-nor-2cs \
    tpm \
    uarts \
    usb-host \
"

DTBOS_NOT_TESTED = " \
    uart10-rs485-option \
    uart6-rs485-option \
    usb0-host-option \
    usb0-otg-option \
"

LINUX_QCOM_KERNEL_DEVICETREE = ""

KERNEL_DEVICETREE = " \
    qcom/${KERNEL_DEVICETREE_BASENAME}.dtb \
    ${@' '.join('qcom/%s.dtbo' % x for x in d.getVar('DTBOS_EXTRA').split())} \
"

FIT_DTB_COMPATIBLE[qcom_qcs6490-iot-subtype5] := "${KERNEL_DEVICETREE_BASENAME} ${DTBOS_EXTRA}"

# Required for the second Ethernet
IMAGE_INSTALL:append = " kernel-module-realtek"
```
